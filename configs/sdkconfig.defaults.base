## configs/sdkconfig.defaults.base
```kconfig
CONFIG_CODEC_I2C_BACKWARD_COMPATIBLE=n
CONFIG_COMPILER_OPTIMIZATION_PERF=y
CONFIG_ESP_DEFAULT_CPU_FREQ_MHZ_240=y
CONFIG_ESP_MAIN_TASK_STACK_SIZE=8192
CONFIG_ESP_COREDUMP_ENABLE_TO_FLASH=y
CONFIG_ESP_COREDUMP_DATA_FORMAT_ELF=y
CONFIG_ESP_COREDUMP_CHECKSUM_CRC32=y
CONFIG_ESP_COREDUMP_CHECK_BOOT=y
CONFIG_ESP_COREDUMP_LOGS=y
CONFIG_ESP_COREDUMP_MAX_TASKS_NUM=32
CONFIG_ESP_COREDUMP_STACK_SIZE=2048
CONFIG_ESP_SYSTEM_EVENT_TASK_STACK_SIZE=4096
CONFIG_ESP_WS_CLIENT_ENABLE_DYNAMIC_BUFFER=y
CONFIG_ESP_WS_CLIENT_SEPARATE_TX_LOCK=y
CONFIG_FREERTOS_HZ=1000
CONFIG_FREERTOS_TIMER_TASK_STACK_DEPTH=4096
CONFIG_IDF_EXPERIMENTAL_FEATURES=y
CONFIG_LK_EXAMPLE_LIVEKIT_FORCE_RELAY=n
CONFIG_LK_EXAMPLE_LIVEKIT_AGENT_RECV_TIMEOUT_MS=5000
# CONFIG_LK_EXAMPLE_LIVEKIT_NO_AUTO_RECONNECT is not set
CONFIG_LK_EXAMPLE_LIVEKIT_KEEP_ROLE=y
CONFIG_LK_EXAMPLE_LIVEKIT_IPV6_SUPPORT=n
CONFIG_LK_EXAMPLE_LIVEKIT_MAX_CANDIDATES=6
CONFIG_LK_EXAMPLE_LIVEKIT_ALIVE_BINDING_RETRIES=20
CONFIG_LK_EXAMPLE_LIVEKIT_PUBLISHER_DATA_CHANNEL=y
# CONFIG_LK_EXAMPLE_LIVEKIT_SUBSCRIBER_DATA_CHANNEL is not set
CONFIG_LK_EXAMPLE_PARTICIPANT_NAME="lichuang-esp32s3"
CONFIG_LK_EXAMPLE_ROOM_NAME="lichuang-room"
CONFIG_LK_EXAMPLE_AUDIO_USE_AEC=y
CONFIG_LK_EXAMPLE_AUDIO_MIC_CHANNEL=0
CONFIG_LK_EXAMPLE_AUDIO_REF_CHANNEL=1
CONFIG_LK_EXAMPLE_AUDIO_INPUT_GAIN_DB=30
CONFIG_LK_EXAMPLE_AUDIO_AFE_HIGH_PERF=y
CONFIG_LK_EXAMPLE_AUDIO_AFE_USE_NS=y
CONFIG_LK_EXAMPLE_AUDIO_AFE_PSRAM=y
CONFIG_LK_EXAMPLE_SPEAKER_VOLUME=80
CONFIG_LK_EXAMPLE_AUDIO_RENDER_RAW_FIFO_KB=16
CONFIG_LK_EXAMPLE_AUDIO_RENDER_FIFO_KB=24
CONFIG_LK_EXAMPLE_UI_BUFFER_LINES=12
CONFIG_LK_EXAMPLE_UI_TRANSFER_LINES=6
# CONFIG_LK_EXAMPLE_UI_USE_PSRAM_BUFFER is not set
CONFIG_LK_EXAMPLE_UI_LVGL_TASK_STACK=4096
CONFIG_LK_EXAMPLE_TIME_SYNC_WAIT_MS=1200
CONFIG_LK_EXAMPLE_USE_WIFI=y
CONFIG_LK_EXAMPLE_WIFI_SETUP_PROVISIONING=y
CONFIG_LK_EXAMPLE_WIFI_AP_SSID_PREFIX="LK-Lichuang"
CONFIG_LK_EXAMPLE_WIFI_AP_LANGUAGE="en-US"
CONFIG_LK_EXAMPLE_WIFI_PROVISIONING_REBOOT_ON_SUCCESS=y
# CONFIG_ESP_WIFI_ENTERPRISE_SUPPORT is not set
# CONFIG_LWIP_IPV6 is not set
CONFIG_LWIP_SNTP_MAX_SERVERS=2
CONFIG_LV_OS_NONE=y
CONFIG_LV_DRAW_BUF_ALIGN=64
CONFIG_LV_FONT_FMT_TXT_LARGE=y
CONFIG_LV_USE_BUILTIN_MALLOC=y
# CONFIG_LV_USE_CLIB_MALLOC is not set
CONFIG_LV_USE_BUILTIN_STRING=y
# CONFIG_LV_USE_CLIB_STRING is not set
CONFIG_LV_USE_BUILTIN_SPRINTF=y
# CONFIG_LV_USE_CLIB_SPRINTF is not set
CONFIG_LV_MEM_SIZE_KILOBYTES=16
# CONFIG_LV_USE_ANIMIMG is not set
# CONFIG_LV_USE_ARC is not set
# CONFIG_LV_USE_ARCLABEL is not set
# CONFIG_LV_USE_BAR is not set
# CONFIG_LV_USE_BUTTON is not set
# CONFIG_LV_USE_BUTTONMATRIX is not set
# CONFIG_LV_USE_CALENDAR is not set
# CONFIG_LV_USE_CANVAS is not set
# CONFIG_LV_USE_CHART is not set
# CONFIG_LV_USE_CHECKBOX is not set
# CONFIG_LV_USE_DROPDOWN is not set
# CONFIG_LV_USE_IMAGEBUTTON is not set
# CONFIG_LV_USE_KEYBOARD is not set
# CONFIG_LV_USE_LED is not set
# CONFIG_LV_USE_LINE is not set
# CONFIG_LV_USE_LIST is not set
# CONFIG_LV_USE_MENU is not set
# CONFIG_LV_USE_MSGBOX is not set
# CONFIG_LV_USE_ROLLER is not set
# CONFIG_LV_USE_SCALE is not set
# CONFIG_LV_USE_SLIDER is not set
# CONFIG_LV_USE_SPAN is not set
# CONFIG_LV_USE_SPINBOX is not set
# CONFIG_LV_USE_SPINNER is not set
# CONFIG_LV_USE_SWITCH is not set
# CONFIG_LV_USE_TEXTAREA is not set
# CONFIG_LV_USE_TABLE is not set
# CONFIG_LV_USE_TABVIEW is not set
# CONFIG_LV_USE_TILEVIEW is not set
# CONFIG_LV_USE_WIN is not set
# CONFIG_LV_USE_GRID is not set
# CONFIG_LV_USE_IMGFONT is not set
# CONFIG_LV_USE_OBSERVER is not set
CONFIG_LV_USE_ASSERT_STYLE=y
CONFIG_LV_USE_FONT_COMPRESSED=n
CONFIG_LV_USE_FONT_PLACEHOLDER=n
# CONFIG_LV_USE_LODEPNG is not set
CONFIG_LV_ATTRIBUTE_MEM_ALIGN_SIZE=64
CONFIG_LV_BUILD_EXAMPLES=n
CONFIG_LV_BUILD_DEMOS=n
CONFIG_MBEDTLS_CERTIFICATE_BUNDLE=y
CONFIG_MBEDTLS_EXTERNAL_MEM_ALLOC=y
CONFIG_MBEDTLS_SSL_DTLS_SRTP=y
CONFIG_MBEDTLS_SSL_PROTO_DTLS=y
CONFIG_PARTITION_TABLE_CUSTOM=y
CONFIG_PARTITION_TABLE_CUSTOM_FILENAME="partitions.csv"
CONFIG_SPIRAM_FETCH_INSTRUCTIONS=y
CONFIG_SPIRAM_MALLOC_ALWAYSINTERNAL=256
CONFIG_SPIRAM_MALLOC_RESERVE_INTERNAL=98304
CONFIG_SPIRAM_TRY_ALLOCATE_WIFI_LWIP=y
CONFIG_SPIRAM=y
```

## configs/sdkconfig.defaults.board.lichuang_esp32s3
```kconfig
CONFIG_IDF_TARGET="esp32s3"
CONFIG_ESP32S3_DATA_CACHE_64KB=y
CONFIG_ESP32S3_DATA_CACHE_LINE_64B=y
CONFIG_ESP32S3_INSTRUCTION_CACHE_32KB=y
CONFIG_ESPTOOLPY_FLASHMODE_QIO=y
CONFIG_ESPTOOLPY_FLASHSIZE_16MB=y
CONFIG_SPIRAM_MODE_OCT=y
CONFIG_SPIRAM_SPEED_80M=y
```

## configs/sdkconfig.defaults.dev
```kconfig
# CONFIG_LK_EXAMPLE_START_IN_STANDBY is not set
CONFIG_LK_EXAMPLE_DEBUG_DOWNLINK_RINGBUF_KB=24
```

## configs/sdkconfig.defaults.test
```kconfig
CONFIG_LK_EXAMPLE_START_IN_STANDBY=y
# CONFIG_LK_EXAMPLE_DEBUG_UPLINK_WAV is not set
# CONFIG_LK_EXAMPLE_DEBUG_UPLINK_WS is not set
# CONFIG_LK_EXAMPLE_LOCAL_AUDIO_UPLINK_ONLY is not set
CONFIG_LK_EXAMPLE_DEBUG_DOWNLINK_RINGBUF_KB=24
```

## main/Kconfig.projbuild
```kconfig
menu "LiveKit ESP32-S3 Configuration"

choice LK_EXAMPLE_AUTH_METHOD
    prompt "LiveKit credentials mode"
    default LK_EXAMPLE_USE_TOKEN_SERVER

    config LK_EXAMPLE_USE_SANDBOX
        bool "LiveKit Cloud Sandbox"

    config LK_EXAMPLE_USE_DEVICE_JWT
        bool "Device-generated JWT"

    config LK_EXAMPLE_USE_TOKEN_SERVER
        bool "Token server"

    config LK_EXAMPLE_USE_PREGENERATED
        bool "Static token"
endchoice

config LK_EXAMPLE_SANDBOX_ID
    string "Sandbox ID"
    depends on LK_EXAMPLE_USE_SANDBOX
    default ""

config LK_EXAMPLE_SERVER_URL
    string "LiveKit server URL"
    depends on LK_EXAMPLE_USE_PREGENERATED || LK_EXAMPLE_USE_DEVICE_JWT
    default ""

config LK_EXAMPLE_TOKEN
    string "LiveKit access token"
    depends on LK_EXAMPLE_USE_PREGENERATED
    default ""

config LK_EXAMPLE_API_KEY
    string "LiveKit API key"
    depends on LK_EXAMPLE_USE_DEVICE_JWT
    default ""

config LK_EXAMPLE_API_SECRET
    string "LiveKit API secret"
    depends on LK_EXAMPLE_USE_DEVICE_JWT
    default ""

config LK_EXAMPLE_DEVICE_JWT_TTL_SECONDS
    int "Device JWT TTL (seconds)"
    depends on LK_EXAMPLE_USE_DEVICE_JWT
    range 60 86400
    default 3600

config LK_EXAMPLE_TOKEN_SERVER_URL
    string "Token server URL"
    depends on LK_EXAMPLE_USE_TOKEN_SERVER
    default ""

config LK_EXAMPLE_TOKEN_SERVER_TIMEOUT_MS
    int "Token server timeout (ms)"
    depends on LK_EXAMPLE_USE_TOKEN_SERVER
    range 1000 30000
    default 5000

config LK_EXAMPLE_TOKEN_SERVER_RETRY_DELAY_MS
    int "Token server retry delay (ms)"
    depends on LK_EXAMPLE_USE_TOKEN_SERVER
    range 1000 60000
    default 3000

config LK_EXAMPLE_TOKEN_SERVER_AUTH_MAX_FAILURES
    int "Max token auth failures before auth expired"
    depends on LK_EXAMPLE_USE_TOKEN_SERVER
    range 1 10
    default 3

config LK_EXAMPLE_ROOM_NAME
    string "Room name"
    default "lichuang-room"

config LK_EXAMPLE_PARTICIPANT_NAME
    string "Participant name"
    default "lichuang-esp32s3"

config LK_EXAMPLE_PARTICIPANT_IDENTITY
    string "Participant identity"
    default ""

config LK_EXAMPLE_PARTICIPANT_METADATA
    string "Participant metadata"
    default ""

config LK_EXAMPLE_AGENT_NAME
    string "LiveKit agent name"
    default ""

config LK_EXAMPLE_AGENT_METADATA
    string "LiveKit agent metadata"
    default ""

config LK_EXAMPLE_LIVEKIT_FORCE_RELAY
    bool "Force relay-only ICE for LiveKit"
    default n

config LK_EXAMPLE_LIVEKIT_AGENT_RECV_TIMEOUT_MS
    int "ICE agent receive timeout (ms)"
    range 100 5000
    default 3000

config LK_EXAMPLE_LIVEKIT_NO_AUTO_RECONNECT
    bool "Disable esp_peer auto reconnect"
    default n

config LK_EXAMPLE_LIVEKIT_KEEP_ROLE
    bool "Keep ICE role across reconnects"
    default y

config LK_EXAMPLE_LIVEKIT_IPV6_SUPPORT
    bool "Enable IPv6 ICE candidates"
    default n

config LK_EXAMPLE_LIVEKIT_MAX_CANDIDATES
    int "Maximum local ICE candidates"
    range 1 16
    default 6

config LK_EXAMPLE_LIVEKIT_ALIVE_BINDING_RETRIES
    int "Peer keepalive binding retries"
    range 1 255
    default 10

config LK_EXAMPLE_LIVEKIT_PUBLISHER_DATA_CHANNEL
    bool "Enable publisher data channel"
    default y

config LK_EXAMPLE_LIVEKIT_SUBSCRIBER_DATA_CHANNEL
    bool "Enable subscriber data channel"
    default n

config LK_EXAMPLE_LIVEKIT_ICE_USE_LITE_MODE
    bool "Enable ICE lite mode"
    default n

config LK_EXAMPLE_USE_WIFI
    bool "Connect over Wi-Fi"
    default y

choice LK_EXAMPLE_WIFI_SETUP_MODE
    prompt "Wi-Fi setup mode"
    depends on LK_EXAMPLE_USE_WIFI
    default LK_EXAMPLE_WIFI_SETUP_PROVISIONING

    config LK_EXAMPLE_WIFI_SETUP_FIXED
        bool "Fixed Wi-Fi credentials"

    config LK_EXAMPLE_WIFI_SETUP_PROVISIONING
        bool "Provisioning portal"
endchoice

config LK_EXAMPLE_WIFI_SSID
    string "Wi-Fi SSID"
    depends on LK_EXAMPLE_USE_WIFI && LK_EXAMPLE_WIFI_SETUP_FIXED
    default ""

config LK_EXAMPLE_WIFI_PASSWORD
    string "Wi-Fi password"
    depends on LK_EXAMPLE_USE_WIFI && LK_EXAMPLE_WIFI_SETUP_FIXED
    default ""

config LK_EXAMPLE_WIFI_AP_SSID_PREFIX
    string "Provisioning AP SSID prefix"
    depends on LK_EXAMPLE_USE_WIFI && LK_EXAMPLE_WIFI_SETUP_PROVISIONING
    default "LK-Lichuang"

config LK_EXAMPLE_WIFI_AP_LANGUAGE
    string "Provisioning page language"
    depends on LK_EXAMPLE_USE_WIFI && LK_EXAMPLE_WIFI_SETUP_PROVISIONING
    default "en-US"

config LK_EXAMPLE_WIFI_PROVISIONING_FORCE_AP
    bool "Always start provisioning AP on boot"
    depends on LK_EXAMPLE_USE_WIFI && LK_EXAMPLE_WIFI_SETUP_PROVISIONING
    default n

config LK_EXAMPLE_WIFI_PROVISIONING_REBOOT_ON_SUCCESS
    bool "Reboot after provisioning success"
    depends on LK_EXAMPLE_USE_WIFI && LK_EXAMPLE_WIFI_SETUP_PROVISIONING
    default y

config LK_EXAMPLE_AUDIO_USE_AEC
    bool "Enable device-side AEC capture"
    default y

config LK_EXAMPLE_AUDIO_MIC_CHANNEL
    int "Microphone input channel"
    range 0 3
    default 0

config LK_EXAMPLE_AUDIO_REF_CHANNEL
    int "Reference input channel"
    depends on LK_EXAMPLE_AUDIO_USE_AEC
    range 0 3
    default 1

config LK_EXAMPLE_AUDIO_INPUT_GAIN_DB
    int "Microphone analog gain (dB)"
    range 0 37
    default 30

config LK_EXAMPLE_SPEAKER_VOLUME
    int "Speaker volume"
    range 0 100
    default 80

config LK_EXAMPLE_AUDIO_DATA_ON_VAD
    bool "Gate AEC capture on local VAD"
    depends on LK_EXAMPLE_AUDIO_USE_AEC
    default n

config LK_EXAMPLE_AUDIO_AFE_HIGH_PERF
    bool "Use high-performance voice-call AFE profile"
    depends on LK_EXAMPLE_AUDIO_USE_AEC
    default y

config LK_EXAMPLE_AUDIO_AFE_USE_NS
    bool "Enable AFE noise suppression when NS model is available"
    depends on LK_EXAMPLE_AUDIO_USE_AEC
    default y

config LK_EXAMPLE_AUDIO_AFE_PSRAM
    bool "Prefer PSRAM for AFE working memory"
    depends on LK_EXAMPLE_AUDIO_USE_AEC && SPIRAM
    default y

config LK_EXAMPLE_AUDIO_RENDER_RAW_FIFO_KB
    int "Audio decoder FIFO size (KiB)"
    range 4 64
    default 16

config LK_EXAMPLE_AUDIO_RENDER_FIFO_KB
    int "Audio render FIFO size (KiB)"
    range 8 128
    default 24

config LK_EXAMPLE_UI_BUFFER_LINES
    int "LVGL draw buffer height (lines)"
    range 4 40
    default 12

config LK_EXAMPLE_UI_TRANSFER_LINES
    int "LVGL transfer buffer height (lines)"
    range 2 20
    default 6

config LK_EXAMPLE_UI_USE_PSRAM_BUFFER
    bool "Store LVGL draw buffer in PSRAM"
    depends on SPIRAM
    default n

config LK_EXAMPLE_UI_LVGL_TASK_STACK
    int "LVGL task stack size"
    range 3072 8192
    default 4096

config LK_EXAMPLE_TIME_SYNC_WAIT_MS
    int "Foreground time sync wait (ms)"
    range 0 10000
    default 1200

config LK_EXAMPLE_START_IN_STANDBY
    bool "Boot into standby and wait for BOOT button before joining room"
    default n

config LK_EXAMPLE_DEBUG_UPLINK_WAV
    bool "Record processed uplink audio to WAV"
    default n

config LK_EXAMPLE_DEBUG_UPLINK_RECORD_SECONDS
    int "Processed uplink WAV duration (seconds)"
    depends on LK_EXAMPLE_DEBUG_UPLINK_WAV
    range 3 120
    default 30

config LK_EXAMPLE_DEBUG_HTTP_PORT
    int "Debug HTTP server port"
    depends on LK_EXAMPLE_DEBUG_UPLINK_WAV
    range 1 65535
    default 8080

config LK_EXAMPLE_DEBUG_UPLINK_WS
    bool "Stream processed uplink audio to local WebSocket"
    depends on !LK_EXAMPLE_DEBUG_UPLINK_WAV
    default n

config LK_EXAMPLE_DEBUG_DOWNLINK_WS
    bool "Stream rendered downlink audio to local WebSocket"
    depends on !LK_EXAMPLE_DEBUG_UPLINK_WAV
    default n

config LK_EXAMPLE_DEBUG_UPLINK_WS_URL
    string "Debug uplink WebSocket URL"
    depends on LK_EXAMPLE_DEBUG_UPLINK_WS
    default ""

config LK_EXAMPLE_DEBUG_DOWNLINK_WS_URL
    string "Debug downlink WebSocket URL"
    depends on LK_EXAMPLE_DEBUG_DOWNLINK_WS
    default ""

config LK_EXAMPLE_DEBUG_DOWNLINK_RINGBUF_KB
    int "Debug downlink ring buffer size (KiB)"
    depends on LK_EXAMPLE_DEBUG_DOWNLINK_WS
    range 8 128
    default 24

config LK_EXAMPLE_DEBUG_UPLINK_WS_RECONNECT_MS
    int "Debug uplink WebSocket reconnect delay (ms)"
    depends on LK_EXAMPLE_DEBUG_UPLINK_WS || LK_EXAMPLE_DEBUG_DOWNLINK_WS
    range 500 30000
    default 3000

config LK_EXAMPLE_LOCAL_AUDIO_UPLINK_ONLY
    bool "Run local audio uplink only (skip LiveKit room join)"
    depends on LK_EXAMPLE_DEBUG_UPLINK_WS
    default n

endmenu
```
